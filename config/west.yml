## config/west.yml
```yaml
manifest:
  remotes:
    - name: moergo-sc
      url-base: https://github.com/moergo-sc
  projects:
    - name: Upgrade west
      run: pip install --upgrade west   
    - name: zmk
      remote: moergo-sc
      revision: main
      import: app/west.yml
  self:
    path: config
```
